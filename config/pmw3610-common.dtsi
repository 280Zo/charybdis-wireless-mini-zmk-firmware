/ {
    #include <zephyr/dt-bindings/input/input-event-codes.h>

    &spi0 {
        /* cs-gpios etc. already set in nice_nano_v2.dts   */
        trackball: trackball@0 {
            compatible = "pixart,pmw3610";
            reg = <0>;
            status = "disabled";          /* default OFF */
            spi-max-frequency = <2000000>;
            irq-gpios = <&gpio0 6 (GPIO_ACTIVE_LOW | GPIO_PULL_UP)>;
            cpi = <600>;
            evt-type = <INPUT_EV_REL>;
            x-input-code = <INPUT_REL_X>;
            y-input-code = <INPUT_REL_Y>;
            force-awake;
        };
    };
};
