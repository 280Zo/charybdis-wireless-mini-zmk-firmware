#include "charybdis.dtsi"

/ {
    chosen {
        zmk,kscan = &mock_kscan;   /* the dongle has no real matrix */
    };

    mock_kscan: kscan_1 {
        compatible = "zmk,kscan-mock";
        columns = <0>;
        rows    = <0>;
        events  = <0>;
    };
};

/* Host-side virtual device that remote halves can target */
&vtrackball { };          /* vtrackball already defined in charybdis.dtsi */