## boards/shields/charybdis-dongle/Kconfig.defconfig
```kconfig
# charybdis-dongle/Kconfig.defconfig
if SHIELD_CHARYBDIS_DONGLE

config ZMK_KEYBOARD_NAME
    default "Charybdis"

config ZMK_SPLIT_ROLE_CENTRAL
    default y

config ZMK_SPLIT
    default y

endif
```

## boards/shields/charybdis-dongle/Kconfig.shield
```kconfig
# boards/shields/charybdis-dongle/Kconfig.shield
config SHIELD_CHARYBDIS_DONGLE
    def_bool $(shields_list_contains,charybdis_dongle)
```

## boards/shields/charybdis-left/Kconfig.defconfig
```kconfig
# charybdis-left/Kconfig.defconfig
if SHIELD_CHARYBDIS_LEFT

config ZMK_KEYBOARD_NAME
    default "Charybdis"

# left is always a peripheral
config ZMK_SPLIT_ROLE_PERIPHERAL
    default y

config ZMK_SPLIT
    default y

endif
```

## boards/shields/charybdis-left/Kconfig.shield
```kconfig
# boards/shields/charybdis-left/Kconfig.shield
config SHIELD_CHARYBDIS_LEFT
    def_bool $(shields_list_contains,charybdis_left)
```

## boards/shields/charybdis-right/Kconfig.defconfig
```kconfig
# charybdis-right/Kconfig.defconfig  (right half)
if SHIELD_CHARYBDIS_RIGHT

config ZMK_KEYBOARD_NAME
    default "Charybdis"

config ZMK_SPLIT_BLE_ROLE_CENTRAL   # <- BT build needs BLE-Central
    default y

config ZMK_SPLIT                   # <- both halves are split
    default y

endif
```

## boards/shields/charybdis-right/Kconfig.shield
```kconfig
# boards/shields/charybdis-right/Kconfig.shield
config SHIELD_CHARYBDIS_RIGHT
    def_bool $(shields_list_contains,charybdis_right)
```

## boards/shields/charybdis_common/Kconfig.reset.defconfig
```kconfig
if SHIELD_RESET

config ZMK_KEYBOARD_NAME
	default "Charybdis Reset"

config SETTINGS
	default y

config ZMK_SETTINGS_RESET_ON_START
	default y

config ZMK_BLE
	default n

config ZMK_DISPLAY
	default n

endif
```

## boards/shields/charybdis_dongle/Kconfig.defconfig
```kconfig
if SHIELD_CHARYBDIS_DONGLE

config ZMK_KEYBOARD_NAME
	default "Charybdis Mini"

config ZMK_SPLIT_ROLE_CENTRAL
	default y

endif

if SHIELD_CHARYBDIS_LEFT || SHIELD_CHARYBDIS_RIGHT || SHIELD_CHARYBDIS_DONGLE

config ZMK_SPLIT
	default y

# Set this to the number of peripherals your dongle will have.
# For a unibody, this would be 1. If you have left and right halves, set it to 2, etc.
config ZMK_SPLIT_BLE_CENTRAL_PERIPHERALS
    default 2

# Set this to ZMK_SPLIT_BLE_CENTRAL_PERIPHERALS + your desired number of BT profiles (default is 5)
config BT_MAX_CONN
    default 7

# Set this to the same number as BT_MAX_CONN
config BT_MAX_PAIRED
    default 7


endif
```

## boards/shields/charybdis_dongle/Kconfig.shield
```kconfig
config SHIELD_CHARYBDIS_DONGLE
	def_bool $(shields_list_contains,charybdis_dongle)
```

## boards/shields/charybdis_dongle_right/Kconfig.defconfig
```kconfig
# charybdis-right/Kconfig.defconfig  (right half)
if SHIELD_CHARYBDIS_RIGHT

config ZMK_KEYBOARD_NAME
    default "Charybdis"

config ZMK_SPLIT
    default y

endif
```

## boards/shields/charybdis_dongle_screen/Kconfig.shield
```kconfig
config SHIELD_CHARYBDIS_DONGLE_SCREEN
	def_bool $(shields_list_contains,charybdis_dongle_screen)
```

## boards/shields/charybdis_dongle_screen_nt/Kconfig.shield
```kconfig
config SHIELD_CHARYBDIS_DONGLE_SCREEN_NT
	def_bool $(shields_list_contains,charybdis_dongle_screen_nt)
```

## boards/shields/charybdis_left_bt/Kconfig.shield
```kconfig
config SHIELD_CHARYBDIS_BT_LEFT
	def_bool $(shields_list_contains,charybdis_left_bt)
```

## boards/shields/charybdis_left_dongle/Kconfig.shield
```kconfig
config SHIELD_CHARYBDIS_DONGLE_LEFT
	def_bool $(shields_list_contains,charybdis_left_dongle)
```

## boards/shields/charybdis_right_bt/Kconfig.shield
```kconfig
config SHIELD_CHARYBDIS_BT_RIGHT
	def_bool $(shields_list_contains,charybdis_right_bt)
```

## boards/shields/charybdis_right_dongle/Kconfig.shield
```kconfig
config SHIELD_CHARYBDIS_DONGLE_RIGHT
	def_bool $(shields_list_contains,charybdis_right_dongle)
```

## config/boards/shields/charybdis-mini-wireless/Kconfig.defconfig
```kconfig
if SHIELD_CHARYBDIS_DONGLE

config ZMK_KEYBOARD_NAME
	default "Charybdis"

config ZMK_SPLIT_BLE_ROLE_CENTRAL
	default y

endif

if SHIELD_CHARYBDIS_LEFT || SHIELD_CHARYBDIS_RIGHT || SHIELD_CHARYBDIS_DONGLE

config ZMK_SPLIT
	default y

config ZMK_BLE
	default y
	
endif
```

## config/boards/shields/charybdis-mini-wireless/Kconfig.shield
```kconfig
config SHIELD_LEFT
	def_bool $(shields_list_contains,left)

config SHIELD_RIGHT
	def_bool $(shields_list_contains,right)
```
