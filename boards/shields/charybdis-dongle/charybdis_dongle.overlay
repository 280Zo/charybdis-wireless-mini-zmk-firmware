#include "charybdis.dtsi"
#include "pmw3610-common.dtsi"   /* ← optional; keeps label roster complete */

&{  /* mock matrix so central image links */
    chosen {
        zmk,kscan = &mock_kscan;
    };

    mock_kscan: kscan_1 {
        compatible = "zmk,kscan-mock";
        columns = <0>;
        rows    = <0>;
        events  = <0>;
    };
};
